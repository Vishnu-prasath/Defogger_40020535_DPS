AUTOSAR XML (schema 00050)
package /ARRoot
  can cluster DefoggerCanCluster
  ecu instance DefoggerEcuInstance
    can communication controller DefoggerCanCommunicationController
    can communication connector DefoggerCanCommunicationConnector
  flat map DefoggerFlatMap: instances=flat-instance-descriptor=DefoggerSystem.Defogger
  composition sw component type DefoggerSwCompositionType
  system DefoggerSystem
    system mapping DefoggerMapping: swc-to-ecu-mapping=component=DefoggerComposition..
    root-software-compositions:
      root sw composition prototype DefoggerComposition
  system DisplaySystem
    system mapping DisplayMapping: swc-to-impl-mapping=DisplayIMP, swc-to-ecu-mapping=component=DisplayComposition..
    root-software-compositions:
      root sw composition prototype DisplayComposition
  can cluster SideMirrorCanCluster
    can physical channel SideMirrorPhysicalChannel: comm-connectors=SideMirrorCanConnector
  ecu instance SideMirrorEcuInstance
    can communication controller SideMirrorCanCommunication
    can communication connector SideMirrorCanConnector: comm-controller=SideMirrorCanCommunication
  flat map SideMirrorFlatMap: instances=flat-instance-descriptor=SideMirrorSystem.SideMirrorSystem
  composition sw component type SideMirrorSwComponentType
  system SideMirrorSystem
    system mapping SideMirrorMapping: swc-to-ecu-mapping=component=SideMirrorComposition..
    root-software-compositions:
      root sw composition prototype SideMirrorComposition
